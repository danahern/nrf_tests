## CMakeLists.txt
```
cmake_minimum_required(VERSION 3.20.0)

find_package(Zephyr REQUIRED HINTS $ENV{ZEPHYR_BASE})
project(alif_b1_idle_test)

target_sources(app PRIVATE src/main.c)
```

## prj.conf
```kconfig
# Minimal idle test - just sleep loop
# Board defconfig handles UART/GPIO/clock defaults

# Disable PM to avoid RTC dependency for now
CONFIG_PM=n

# Disable BLE
CONFIG_BT=n

# Disable logging for clean measurement
CONFIG_LOG=n
CONFIG_BOOT_BANNER=n

# Minimal stacks
CONFIG_MAIN_STACK_SIZE=1024
```

## src/main.c
```c
/*
 * Alif B1 Deep Sleep Idle Test
 *
 * Enters lowest power idle state (STOP mode) with periodic 1-second wakeup.
 * All peripherals disabled for minimum power consumption.
 * Target: 700 nA (per Alif B1 datasheet).
 */

#include <zephyr/kernel.h>

int main(void)
{
	while (1) {
		k_sleep(K_SECONDS(1));
	}
	return 0;
}
```
