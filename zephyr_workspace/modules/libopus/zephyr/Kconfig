## zephyr_workspace/modules/libopus/zephyr/Kconfig
```kconfig
# libopus Zephyr module.
#
# Vendored under zephyr_workspace/modules/libopus/opus (git submodule pinned
# to upstream xiph/opus v1.5.2). Fixed-point only; float API disabled.

config ZEPHYR_LIBOPUS_MODULE
	bool

menuconfig OPUS
	bool "libopus (fixed-point)"
	help
	  Enable the libopus codec. Build is forced to fixed-point with the
	  float API disabled to avoid pulling an FPU dependency. Targets
	  16 kHz mono speech @ ~16 kbps for the PSE84 voice-assistant app.
	  When disabled the module adds no sources and the library symbol
	  `opus` still exists as an INTERFACE target so apps can
	  unconditionally `target_link_libraries(app PRIVATE opus)`.

if OPUS

config OPUS_CUSTOM_MODES
	bool "Enable custom modes (non-standard sample rates)"
	default n

endif # OPUS
```

## zephyr_workspace/pse84_assistant/tests/framing/testcase.yaml
```yaml
common:
  tags:
    - pse84_assistant
    - framing
  platform_allow:
    - native_sim
    - native_sim/native/64
    # Track D: smoke-test the framing code path on a real Cortex-M55 ISA
    # (Armv8.1-M + MVE) under QEMU.
    - mps3/corstone300/an547
  integration_platforms:
    - native_sim
    - native_sim/native/64
    - mps3/corstone300/an547
tests:
  pse84_assistant.framing: {}
```

## zephyr_workspace/pse84_assistant/tests/mbox_pse84/testcase.yaml
```yaml
common:
  tags:
    - pse84_assistant
    - mbox
  # PDL header is only provided by the test shim on native_sim. HW and
  # QEMU M55 platforms get the real hal_infineon PDL and a full SoC
  # build — out of scope for Phase 0b.1 (tracked as 0b.2 onwards).
  platform_allow:
    - native_sim
    - native_sim/native/64
  integration_platforms:
    - native_sim
    - native_sim/native/64
tests:
  pse84_assistant.mbox_pse84: {}
```

## zephyr_workspace/pse84_assistant/tests/opus_roundtrip/testcase.yaml
```yaml
common:
  tags:
    - pse84_assistant
    - opus
  platform_allow:
    - native_sim
    - native_sim/native/64
    # Track D: smoke-test libopus (FIXED_POINT=1, no-float) on a real
    # Cortex-M55 with MVE under QEMU.
    - mps3/corstone300/an547
  integration_platforms:
    - native_sim
    - native_sim/native/64
    - mps3/corstone300/an547
  # libopus TUs emit a lot of benign warnings that do not deserve a test
  # failure.
  build_only: false
tests:
  pse84_assistant.opus_roundtrip: {}
```
