## CMakeLists.txt
```
cmake_minimum_required(VERSION 3.20.0)

find_package(Zephyr REQUIRED HINTS $ENV{ZEPHYR_BASE})
project(nrf54lm20_idle_test)

target_sources(app PRIVATE src/main.c)
```

## prj.conf
```kconfig
# Power management
CONFIG_PM=y
CONFIG_PM_DEVICE=y

# Disable everything for lowest power
CONFIG_SERIAL=n
CONFIG_CONSOLE=n
CONFIG_UART_CONSOLE=n
CONFIG_PRINTK=n
CONFIG_LOG=n
CONFIG_BT=n
CONFIG_GPIO=n

# Enable GRTC for RTC wakeup
CONFIG_NRF_GRTC_START_SYSCOUNTER=y

# Minimal system
CONFIG_MAIN_STACK_SIZE=1024
```

## src/main.c
```c
/*
 * nRF54LM20 Deep Sleep Idle Test
 *
 * Enters lowest power idle state with periodic 1-second RTC wakeup.
 * All peripherals disabled for minimum power consumption.
 */

#include <zephyr/kernel.h>

int main(void)
{
	while (1) {
		k_sleep(K_SECONDS(1));
	}
	return 0;
}
```
